## imu/sdkconfig.defaults
```kconfig
#
# ESP32-specific
#
CONFIG_ESP32_DEFAULT_CPU_FREQ_240=y
CONFIG_ESP32_DEFAULT_CPU_FREQ_MHZ=240

#
# Disable WatchDog
#
CONFIG_ESP_INT_WDT=n
CONFIG_INT_WDT=n
CONFIG_TASK_WDT=n
CONFIG_ESP_TASK_WDT_EN=n
```

## main/Kconfig.projbuild
```kconfig
menu "M5Stick-C Plus Configuration"

	choice DEVICE_SELECT
		prompt "M5STICK_C_PLUS/M5STICK_C_PLUS2"
		default M5STICK_C_PLUS
		help
			Select SPI peripheral that controls this bus.
		config M5STICK_C_PLUS
			bool "M5STICK_C_PLUS"
			help
				Device is M5STICK_C_PLUS.
		config M5STICK_C_PLUS2
			bool "M5STICK_C_PLUS2"
			help
				Device is M5STICK_C_PLUS2.
	endchoice

endmenu
```
